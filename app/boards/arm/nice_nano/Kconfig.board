## app/boards/arm/nice_nano/Kconfig.board
```kconfig
# nice!nano board configuration

# Copyright (c) 2020 Pete Johanson
# SPDX-License-Identifier: MIT

config BOARD_NICE_NANO
	bool "nice!nano"
	depends on SOC_NRF52840_QIAA

config BOARD_NICE_NANO_V2
	bool "nice!nano v2"
	depends on SOC_NRF52840_QIAA

config BOARD_CORNEISH_ZEN_V2_LEFT
	bool "corneish zen left v2"
	depends on SOC_NRF52840_QIAA

config BOARD_CORNEISH_ZEN_V2_RIGHT
	bool "corneish zen right v2"
	depends on SOC_NRF52840_QIAA
```

## app/boards/arm/nice_nano/Kconfig.defconfig
```kconfig
# Copyright (c) 2021 The ZMK Contributors
# SPDX-License-Identifier: MIT

if BOARD_NICE_NANO || BOARD_NICE_NANO_V2

config BOARD
	default "nice_nano"

if USB_DEVICE_STACK

config USB_NRFX
	default y

endif # USB_DEVICE_STACK

config BT_CTLR
	default BT

config ZMK_BLE
	default y

config ZMK_USB
	default y

config ZMK_DISPLAY
	select LVGL_USE_CONT
	select LVGL_FONT_MONTSERRAT_26
	select LVGL_FONT_MONTSERRAT_20
	select LVGL_FONT_MONTSERRAT_16
	select LVGL_USE_LABEL
	select LVGL_USE_IMG


choice ZMK_DISPLAY_STATUS_SCREEN
	default ZMK_DISPLAY_STATUS_SCREEN_CUSTOM
endchoice


menuconfig CUSTOM_WIDGET_BATTERY_STATUS
	bool "custom battery status widget"

menuconfig CUSTOM_WIDGET_OUTPUT_STATUS
	bool "custom output status widget"

menuconfig CUSTOM_WIDGET_LAYER_STATUS
	bool "custom layer status widget"

menuconfig CUSTOM_WIDGET_PERIPHERAL_STATUS
	bool "custom peripheral status widget"

endif # BOARD_NICE_NANO || BOARD_NICE_NANO_V2
```

## app/boards/shields/corne/Kconfig.defconfig
```kconfig
if SHIELD_CORNE_LEFT

config ZMK_KEYBOARD_NAME
	default "Corne"

config ZMK_SPLIT_ROLE_CENTRAL
	default y

endif

if SHIELD_CORNE_LEFT || SHIELD_CORNE_RIGHT

config ZMK_SPLIT
	default y

if ZMK_DISPLAY
config ZMK_DISPLAY
	select LVGL_USE_CONT
	select LVGL_FONT_MONTSERRAT_26
	select LVGL_FONT_MONTSERRAT_20
	select LVGL_FONT_MONTSERRAT_16
	select LVGL_USE_LABEL
	select LVGL_USE_IMG

choice ZMK_DISPLAY_STATUS_SCREEN
	default ZMK_DISPLAY_STATUS_SCREEN_CUSTOM
endchoice

menuconfig CUSTOM_WIDGET_BATTERY_STATUS
	bool "custom battery status widget"

menuconfig CUSTOM_WIDGET_OUTPUT_STATUS
	bool "custom output status widget"

menuconfig CUSTOM_WIDGET_LAYER_STATUS
	bool "custom layer status widget"

menuconfig CUSTOM_WIDGET_PERIPHERAL_STATUS
	bool "custom peripheral status widget"

config I2C
	default y

config SSD1306
	default y

config SSD1306_REVERSE_MODE
	default y

endif # ZMK_DISPLAY

if LVGL

config LVGL_VDB_SIZE
	default 64

config LVGL_DPI
	default 148

config LVGL_BITS_PER_PIXEL
	default 1

choice LVGL_COLOR_DEPTH
	default LVGL_COLOR_DEPTH_1
endchoice

endif # LVGL

endif
```
